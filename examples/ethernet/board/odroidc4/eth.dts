
/ {

	soc {
		ethernet@ff3f0000 {
			compatible = "amlogic,meson-g12a-dwmac\0snps,dwmac-3.70a\0snps,dwmac";
			reg = <0x00 0xff3f0000 0x00 0x10000 0x00 0xff634540 0x00 0x08>;
			interrupts = <0x00 0x08 0x04>;
			interrupt-names = "macirq";
			clocks = <0x02 0x26 0x02 0x02 0x02 0x0d 0x02 0x02>;
			clock-names = "stmmaceth\0clkin0\0clkin1\0timing-adjustment";
			rx-fifo-depth = <0x1000>;
			tx-fifo-depth = <0x800>;
			status = "okay";
			power-domains = <0x03 0x06>;
			pinctrl-0 = <0x07 0x08>;
			pinctrl-names = "default";
			phy-mode = "rgmii";
			phy-handle = <0x09>;
			amlogic,tx-delay-ns = <0x02>;

			mdio {
				#address-cells = <0x01>;
				#size-cells = <0x00>;
				compatible = "snps,dwmac-mdio";
				phandle = <0x13>;
			};
		};
    };
};