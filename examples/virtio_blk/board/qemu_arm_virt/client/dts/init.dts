/ {
    /delete-node/ memory@40000000;
    /delete-node/ chosen;

    memory@40000000 {
		reg = <0x00 0x40000000 0x00 0x10000000>;
		device_type = "memory";
	};

	chosen {
		stdout-path = "/pl011@9000000";
		bootargs = "earlycon=pl011,0x9000000 earlyprintk=serial debug pci=nomsi loglevel=8";
		linux,stdout-path = "/pl011@9000000";
		linux,initrd-start = <0x4d700000>;
		linux,initrd-end = <0x4e000000>;
	};
};