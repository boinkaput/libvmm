// this overlay contains UIO entries for the guest driver
/ {
	uio {
		compatible = "generic-uio\0uio";
		reg = <0x00 0x30000000 0x00 0x20000 0x00 0x30200000 0x00 0x20000 0x00 0x30400000 0x00 0x20000 0x00 0x30600000 0x00 0x20000 0x00>;
		interrupts = <0x00 0x0a 0x04>;
	};
};